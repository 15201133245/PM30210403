#if LCD_TYPE==1		//OK
#include "global.h"
#define		SYSCOM				0x40
#define		NWRITE				0x42
#define		MREAD				0x43
#define		SCRCOM				0x44
#define		CSRW				0x46
#define		CS_RIGHT			0x4c
#define		CS_LEFT				0x4d
#define		CS_UP				0x4e
#define		CS_DOWN				0x4f
#define		DISPLAY_ON			0x59
#define		OVLAY				0x5b
const char SYSTAB[] = {0x30,0x87,0x0f,0x27,0x30,0xef,0x30,0x00};
const char SCRTAB[] = {0x00,0x00,0xef,0x00,0x40,0xef,0x00,0x80,0x00,0x00};
const char Logic_XOR_OR = 0x0d;

static const unsigned char AT45_ERROR0[] = "DATAFLASH0-ERR";
static const unsigned char AT45_ERROR1[] = "DATAFLASH1-ERR";
static const unsigned char RECORD_ERR[] = "RECORD-ERR";
static const unsigned char CHARAC_LIB_ERR[] = "CHARAC-LIB-ERR";

const unsigned char holdLow[] = {0x00,0x01,0x03,0x07,0x0f,0x1f,0x3f,0x7f,0xff};
const unsigned char holdHigh[] = {0x00,0x80,0xc0,0xe0,0xf0,0xf8,0xfc,0xfe,0xff};
const unsigned char andTab[] = {0x7f,0xbf,0xdf,0xef,0xf7,0xfb,0xfd,0xfe,0xff};
const unsigned char orTab[] = {0x80,0x40,0x20,0x10,0x08,0x04,0x02,0x01,0x00};

const unsigned char computer_zimo[] = {
	0x00,0x00,0x1F,0xF8,0x2F,0xF4,0x30,0x0C,0x30,0x0C,0x30,0x0C,0x30,0x0C,0x30,0x0C,
	0x30,0x0C,0x2F,0xF4,0x1F,0xF8,0x01,0x80,0x3F,0xFC,0x7F,0xFE,0x00,0x00,0x00,0x00
};

const unsigned char pumpOnline[] = {
	0x00,0x00,0x0F,0xF8,0x1F,0xF8,0x2C,0x18,0x2C,0x18,0x2C,0x18,0x1C,0x18,0x1C,0x18,
	0x2C,0x18,0x2C,0x18,0x2C,0x18,0x1C,0x18,0x0C,0x18,0x1F,0xFC,0x3F,0xFE,0x00,0x00
};

const unsigned char pumpOffline[] = {
	0x00,0x00,0x0F,0xF8,0x0F,0xF8,0x0C,0x18,0x0C,0x18,0x0C,0x18,0x0C,0x18,0x0C,0x18,
	0x0C,0x18,0x0C,0x18,0x0C,0x18,0x0C,0x18,0x0C,0x18,0x1F,0xFC,0x3F,0xFE,0x00,0x00
};

//16 * 29
const unsigned char NumChar[38][58] = {
	{	//0
		0x00,0x00,0x00,0x00,0x00,0x00,0x00,0x00,0x07,0xE0,0x1F,0xF8,0x1C,0x38,0x3C,0x3C,
		0x38,0x1C,0x78,0x1E,0x78,0x1E,0x78,0x1E,0x70,0x0E,0x70,0x0E,0x70,0x0E,0x70,0x0E,
		0x70,0x0E,0x78,0x1E,0x78,0x1E,0x78,0x1E,0x38,0x1C,0x3C,0x3C,0x1C,0x38,0x1F,0xF8,
		0x07,0xE0,0x00,0x00,0x00,0x00,0x00,0x00,0x00,0x00
	},
	{	//1
		0x00,0x00,0x00,0x00,0x00,0x00,0x00,0x00,0x01,0xC0,0x0F,0xC0,0x3F,0xC0,0x03,0xC0,
		0x01,0xC0,0x01,0xC0,0x01,0xC0,0x01,0xC0,0x01,0xC0,0x01,0xC0,0x01,0xC0,0x01,0xC0,
		0x01,0xC0,0x01,0xC0,0x01,0xC0,0x01,0xC0,0x01,0xC0,0x01,0xC0,0x01,0xC0,0x07,0xF0,
		0x1F,0xFE,0x00,0x00,0x00,0x00,0x00,0x00,0x00,0x00
	},
	{	//2
		0x00,0x00,0x00,0x00,0x00,0x00,0x00,0x00,0x0F,0xF0,0x1E,0xF8,0x3C,0x3C,0x38,0x3C,
		0x3C,0x1C,0x3C,0x1C,0x3C,0x3C,0x00,0x3C,0x00,0x38,0x00,0x78,0x00,0xF0,0x01,0xE0,
		0x03,0xC0,0x07,0x80,0x07,0x00,0x0E,0x0E,0x1C,0x0C,0x38,0x1C,0x30,0x3C,0x7F,0xFC,
		0x7F,0xF8,0x00,0x00,0x00,0x00,0x00,0x00,0x00,0x00
	},
	{	//3
		0x00,0x00,0x00,0x00,0x00,0x00,0x00,0x00,0x0F,0xF0,0x1F,0x78,0x3C,0x3C,0x3C,0x3C,
		0x3C,0x1C,0x3C,0x1C,0x00,0x3C,0x00,0x38,0x01,0xF0,0x07,0xC0,0x00,0xF0,0x00,0x38,
		0x00,0x3C,0x00,0x1C,0x00,0x1C,0x78,0x1C,0x78,0x3C,0x78,0x3C,0x78,0x78,0x3E,0xF8,
		0x1F,0xE0,0x00,0x00,0x00,0x00,0x00,0x00,0x00,0x00
	},
	{	//4
		0x00,0x00,0x00,0x00,0x00,0x00,0x00,0x00,0x00,0x70,0x00,0x70,0x00,0xF0,0x01,0xF0,
		0x01,0xF0,0x03,0xF0,0x03,0x70,0x06,0x70,0x0E,0x70,0x0C,0x70,0x1C,0x70,0x38,0x70,
		0x30,0x70,0x70,0x70,0x7F,0xFF,0x00,0x70,0x00,0x70,0x00,0x70,0x00,0x70,0x00,0xF8,
		0x03,0xFE,0x00,0x00,0x00,0x00,0x00,0x00,0x00,0x00
	},
	{	//5
		0x00,0x00,0x00,0x00,0x00,0x00,0x00,0x00,0x1F,0xFC,0x3F,0xFC,0x38,0x00,0x38,0x00,
		0x38,0x00,0x38,0x00,0x38,0x00,0x38,0x00,0x3F,0xF0,0x3F,0x78,0x3C,0x3C,0x38,0x1E,
		0x00,0x1E,0x00,0x0E,0x00,0x0E,0x78,0x0E,0x78,0x1E,0x78,0x1E,0x78,0x3C,0x3E,0xF8,
		0x0F,0xF0,0x00,0x00,0x00,0x00,0x00,0x00,0x00,0x0
	},
	{	//6
		0x00,0x00,0x00,0x00,0x00,0x00,0x00,0x00,0x07,0xF8,0x0F,0x7C,0x1E,0x3C,0x1C,0x3C,
		0x3C,0x18,0x38,0x00,0x78,0x00,0x78,0x00,0x7B,0xF8,0x7F,0x7C,0x7C,0x3C,0x78,0x1E,
		0x78,0x1E,0x70,0x0E,0x70,0x0E,0x78,0x0E,0x78,0x1E,0x38,0x1E,0x3C,0x3C,0x1F,0x78,
		0x0F,0xF0,0x00,0x00,0x00,0x00,0x00,0x00,0x00,0x00
	},
	{	//7
		0x00,0x00,0x00,0x00,0x00,0x00,0x00,0x00,0x1F,0xFE,0x1F,0xFE,0x3C,0x0E,0x38,0x0C,
		0x38,0x18,0x30,0x38,0x00,0x30,0x00,0x70,0x00,0x60,0x00,0xE0,0x00,0xC0,0x01,0xC0,
		0x01,0x80,0x03,0x80,0x03,0x80,0x07,0x80,0x07,0x00,0x07,0x00,0x07,0x00,0x07,0x00,
		0x07,0x00,0x00,0x00,0x00,0x00,0x00,0x00,0x00,0x00
	},
	{	//8
		0x00,0x00,0x00,0x00,0x00,0x00,0x00,0x00,0x0F,0xE0,0x1E,0xF0,0x38,0x38,0x38,0x38,
		0x30,0x18,0x38,0x18,0x38,0x38,0x3C,0x78,0x1F,0xF0,0x0F,0xE0,0x0F,0xE0,0x1F,0xF8,
		0x3C,0x7C,0x78,0x3C,0x78,0x1C,0x70,0x0C,0x70,0x0C,0x78,0x1C,0x78,0x1C,0x3E,0xF8,
		0x1F,0xE0,0x00,0x00,0x00,0x00,0x00,0x00,0x00,0x00
	},
	{	//9
		0x00,0x00,0x00,0x00,0x00,0x00,0x00,0x00,0x0F,0xE0,0x1E,0xF0,0x3C,0x78,0x78,0x38,
		0x78,0x3C,0x70,0x3C,0x70,0x1C,0x70,0x1C,0x70,0x1C,0x78,0x3C,0x78,0x7C,0x3C,0xFC,
		0x1F,0xFC,0x00,0x3C,0x00,0x3C,0x00,0x38,0x3C,0x38,0x3C,0x78,0x3C,0x70,0x3F,0xE0,
		0x1F,0xC0,0x00,0x00,0x00,0x00,0x00,0x00,0x00,0x00
	},
	{	//A
		0x00,0x00,0x00,0x00,0x00,0x00,0x00,0x00,0x01,0xC0,0x03,0xC0,0x03,0xC0,0x03,0xE0,
		0x07,0xE0,0x06,0xE0,0x06,0xE0,0x0E,0xF0,0x0C,0xF0,0x0C,0x70,0x0C,0x78,0x1C,0x78,
		0x1F,0xF8,0x18,0x38,0x38,0x3C,0x38,0x3C,0x38,0x3C,0x70,0x3C,0x70,0x1E,0xF0,0x3E,
		0xF8,0x7F,0x00,0x00,0x00,0x00,0x00,0x00,0x00,0x00
	},
	{	//B
		0x00,0x00,0x00,0x00,0x00,0x00,0x00,0x00,0xFF,0xF0,0x7C,0xF8,0x38,0x3C,0x38,0x3C,
		0x38,0x1C,0x38,0x1C,0x38,0x3C,0x38,0x3C,0x38,0x78,0x38,0xE0,0x3F,0xF8,0x38,0xFC,
		0x38,0x3E,0x38,0x1E,0x38,0x1E,0x38,0x0E,0x38,0x0E,0x38,0x1E,0x38,0x3C,0x7C,0xFC,
		0xFF,0xF0,0x00,0x00,0x00,0x00,0x00,0x00,0x00,0x00
	},
	{	//C
		0x00,0x00,0x00,0x00,0x00,0x00,0x00,0x00,0x07,0xFC,0x0F,0x7C,0x1E,0x1C,0x3C,0x0E,
		0x38,0x06,0x78,0x00,0x78,0x00,0x78,0x00,0x70,0x00,0x70,0x00,0x70,0x00,0x70,0x00,
		0x70,0x00,0x78,0x00,0x78,0x00,0x78,0x07,0x38,0x06,0x3C,0x0E,0x1E,0x1C,0x0F,0xB8,
		0x07,0xF0,0x00,0x00,0x00,0x00,0x00,0x00,0x00,0x00
	},
	{	//D
		0x00,0x00,0x00,0x00,0x00,0x00,0x00,0x00,0xFF,0xE0,0x7D,0xF0,0x38,0x78,0x38,0x3C,
		0x38,0x3C,0x38,0x1E,0x38,0x1E,0x38,0x1E,0x38,0x0E,0x38,0x0E,0x38,0x0E,0x38,0x0E,
		0x38,0x0E,0x38,0x1E,0x38,0x1E,0x38,0x1E,0x38,0x3C,0x38,0x3C,0x38,0x78,0x7D,0xF0,
		0xFF,0xE0,0x00,0x00,0x00,0x00,0x00,0x00,0x00,0x00
	},
	{	//E
		0x00,0x00,0x00,0x00,0x00,0x00,0x00,0x00,0xFF,0xFC,0x7C,0x7C,0x38,0x1C,0x38,0x0E,
		0x38,0x06,0x38,0x60,0x38,0x60,0x38,0xE0,0x39,0xE0,0x3F,0xE0,0x39,0xE0,0x38,0xE0,
		0x38,0xE0,0x38,0x60,0x38,0x00,0x38,0x00,0x38,0x06,0x38,0x0E,0x38,0x1E,0x7C,0x7E,
		0xFF,0xFC,0x00,0x00,0x00,0x00,0x00,0x00,0x00,0x00
	},
	{	//F
		0x00,0x00,0x00,0x00,0x00,0x00,0x00,0x00,0xFF,0xFC,0x7C,0x7C,0x38,0x1E,0x38,0x0E,
		0x38,0x06,0x38,0x30,0x38,0x30,0x38,0x70,0x38,0xF0,0x3F,0xF0,0x38,0xF0,0x38,0x70,
		0x38,0x70,0x38,0x30,0x38,0x00,0x38,0x00,0x38,0x00,0x38,0x00,0x38,0x00,0x7C,0x00,
		0xFF,0x00,0x00,0x00,0x00,0x00,0x00,0x00,0x00,0x00
	},
	{	//G
		0x00,0x00,0x00,0x00,0x00,0x00,0x00,0x00,0x0F,0xF8,0x1E,0xF8,0x3C,0x38,0x78,0x1C,
		0x78,0x0C,0xF0,0x00,0xF0,0x00,0xF0,0x00,0xE0,0x00,0xE0,0x00,0xE0,0x00,0xE0,0xFF,
		0xE0,0x3E,0xF0,0x1C,0xF0,0x1C,0xF0,0x1C,0x78,0x1C,0x78,0x3C,0x3C,0x3C,0x1E,0xFC,
		0x0F,0xFC,0x00,0x00,0x00,0x00,0x00,0x00,0x00,0x00
	},
	{	//H
		0x00,0x00,0x00,0x00,0x00,0x00,0x00,0x00,0xFE,0xFE,0x7C,0x7C,0x38,0x38,0x38,0x38,
		0x38,0x38,0x38,0x38,0x38,0x38,0x38,0x38,0x38,0x38,0x38,0x38,0x3F,0xF8,0x38,0x38,
		0x38,0x38,0x38,0x38,0x38,0x38,0x38,0x38,0x38,0x38,0x38,0x38,0x38,0x38,0x7C,0x7C,
		0xFE,0xFE,0x00,0x00,0x00,0x00,0x00,0x00,0x00,0x00
	},
	{	//I
		0x00,0x00,0x00,0x00,0x00,0x00,0x00,0x00,0x1F,0xF0,0x07,0xC0,0x03,0x80,0x03,0x80,
		0x03,0x80,0x03,0x80,0x03,0x80,0x03,0x80,0x03,0x80,0x03,0x80,0x03,0x80,0x03,0x80,
		0x03,0x80,0x03,0x80,0x03,0x80,0x03,0x80,0x03,0x80,0x03,0x80,0x03,0x80,0x0F,0xC0,
		0x1F,0xF0,0x00,0x00,0x00,0x00,0x00,0x00,0x00,0x00
	},
	{	//J
		0x00,0x00,0x00,0x00,0x00,0x00,0x00,0x00,0x07,0xFC,0x03,0xF0,0x00,0xE0,0x00,0xE0,
		0x00,0xE0,0x00,0xE0,0x00,0xE0,0x00,0xE0,0x00,0xE0,0x00,0xE0,0x00,0xE0,0x00,0xE0,
		0x00,0xE0,0x00,0xE0,0x00,0xE0,0x00,0xE0,0x00,0xE0,0x01,0xE0,0x79,0xE0,0x7F,0xC0,
		0x7F,0x80,0x00,0x00,0x00,0x00,0x00,0x00,0x00,0x00
	},
	{	//K
		0x00,0x00,0x00,0x00,0x00,0x00,0x00,0x00,0xFF,0xFE,0x7C,0x78,0x38,0x70,0x38,0x60,
		0x38,0xE0,0x39,0xC0,0x39,0xC0,0x3B,0x80,0x3B,0x80,0x3F,0x80,0x3F,0xC0,0x3F,0xC0,
		0x3D,0xE0,0x39,0xE0,0x38,0xF0,0x38,0xF0,0x38,0x70,0x38,0x78,0x38,0x38,0x7C,0x7C,
		0xFE,0xFF,0x00,0x00,0x00,0x00,0x00,0x00,0x00,0x00
	},
	{ 	//L
		0x00,0x00,0x00,0x00,0x00,0x00,0x00,0x00,0xFE,0x00,0x7C,0x00,0x38,0x00,0x38,0x00,
		0x38,0x00,0x38,0x00,0x38,0x00,0x38,0x00,0x38,0x00,0x38,0x00,0x38,0x00,0x38,0x00,
		0x38,0x00,0x38,0x00,0x38,0x00,0x38,0x00,0x38,0x06,0x38,0x0E,0x38,0x1E,0x7C,0xFC,
		0xFF,0xFC,0x00,0x00,0x00,0x00,0x00,0x00,0x00,0x00
	},
	{	//M
		0x00,0x00,0x00,0x00,0x00,0x00,0x00,0x00,0xFC,0x3F,0x7C,0x3E,0x3C,0x3C,0x3C,0x3C,
		0x3C,0x7C,0x3E,0x7C,0x3E,0x7C,0x3E,0x7C,0x3E,0x7C,0x3E,0xFC,0x3F,0xFC,0x37,0xFC,
		0x37,0xFC,0x37,0xFC,0x37,0xDC,0x37,0xDC,0x33,0xDC,0x33,0xDC,0x33,0xDC,0x7B,0xFE,
		0xFF,0xFF,0x00,0x00,0x00,0x00,0x00,0x00,0x00,0x00
	},
	{	//N
		0x00,0x00,0x00,0x00,0x00,0x00,0x00,0x00,0xF8,0x7F,0x78,0x3E,0x3C,0x1C,0x3C,0x1C,
		0x3E,0x1C,0x3E,0x1C,0x3F,0x1C,0x37,0x1C,0x37,0x1C,0x33,0x9C,0x33,0x9C,0x31,0xDC,
		0x31,0xDC,0x30,0xFC,0x30,0xFC,0x30,0x7C,0x30,0x7C,0x30,0x3C,0x30,0x3C,0x78,0x1C,
		0xFC,0x1C,0x00,0x00,0x00,0x00,0x00,0x00,0x00,0x00
	},
	{	//O
		0x00,0x00,0x00,0x00,0x00,0x00,0x00,0x00,0x0F,0xE0,0x1E,0xF0,0x3C,0x78,0x78,0x3C,
		0x70,0x1C,0xF0,0x1E,0xF0,0x1E,0xF0,0x1E,0xE0,0x0E,0xE0,0x0E,0xE0,0x0E,0xE0,0x0E,
		0xE0,0x0E,0xF0,0x1E,0xF0,0x1E,0xF0,0x1E,0x70,0x1C,0x78,0x3C,0x3C,0x78,0x1E,0xF0,
		0x0F,0xE0,0x00,0x00,0x00,0x00,0x00,0x00,0x00,0x00
	},
	{	//P
		0x00,0x00,0x00,0x00,0x00,0x00,0x00,0x00,0xFF,0xF8,0x7C,0x7C,0x38,0x3E,0x38,0x1E,
		0x38,0x0E,0x38,0x0E,0x38,0x0E,0x38,0x1E,0x38,0x1E,0x38,0x3C,0x3F,0xF0,0x38,0x00,
		0x38,0x00,0x38,0x00,0x38,0x00,0x38,0x00,0x38,0x00,0x38,0x00,0x38,0x00,0x7C,0x00,
		0xFE,0x00,0x00,0x00,0x00,0x00,0x00,0x00,0x00,0x00
	},
	{	//Q
		0x00,0x00,0x00,0x00,0x00,0x00,0x00,0x00,0x0F,0xC0,0x3F,0xF0,0x3C,0x70,0x78,0x78,
		0x70,0x38,0xF0,0x3C,0xF0,0x3C,0xF0,0x3C,0xF0,0x3C,0xE0,0x1C,0xE0,0x1C,0xE0,0x1C,
		0xE0,0x1C,0xE0,0x1C,0xF0,0x3C,0xF7,0x3C,0x7D,0xB8,0x78,0xF8,0x3C,0xF0,0x1E,0xE0,
		0x0F,0xF0,0x00,0x78,0x00,0x7E,0x00,0x3C,0x00,0x00
	},
	{	//R
		0x00,0x00,0x00,0x00,0x00,0x00,0x00,0x00,0xFF,0xF0,0x7C,0xF8,0x38,0x3C,0x38,0x3C,
		0x38,0x1C,0x38,0x1C,0x38,0x1C,0x38,0x3C,0x38,0x38,0x38,0xF0,0x3F,0xE0,0x3B,0xC0,
		0x39,0xC0,0x39,0xE0,0x38,0xE0,0x38,0xF0,0x38,0xF0,0x38,0x70,0x38,0x78,0x7C,0x3C,
		0xFE,0x3F,0x00,0x00,0x00,0x00,0x00,0x00,0x00,0x00
	},
	{	//S
		0x00,0x00,0x00,0x00,0x00,0x00,0x00,0x00,0x0F,0xF8,0x1E,0xFC,0x3C,0x3C,0x38,0x1E,
		0x38,0x0E,0x3C,0x00,0x3C,0x00,0x3E,0x00,0x1F,0xC0,0x0F,0xF0,0x03,0xF8,0x00,0xFC,
		0x00,0x3E,0x00,0x1E,0x00,0x1E,0x00,0x0E,0x60,0x0E,0x70,0x1E,0x3C,0x1E,0x3F,0x7C,
		0x3F,0xF8,0x00,0x00,0x00,0x00,0x00,0x00,0x00,0x00
	},
	{	//T
		0x00,0x00,0x00,0x00,0x00,0x00,0x00,0x00,0xFF,0xFC,0xFF,0xDE,0xE3,0x8E,0xE3,0x8E,
		0xC3,0x87,0x83,0x86,0x03,0x80,0x03,0x80,0x03,0x80,0x03,0x80,0x03,0x80,0x03,0x80,
		0x03,0x80,0x03,0x80,0x03,0x80,0x03,0x80,0x03,0x80,0x03,0x80,0x03,0x80,0x07,0xC0,
		0x1F,0xF0,0x00,0x00,0x00,0x00,0x00,0x00,0x00,0x00
	},
	{	//U
		0x00,0x00,0x00,0x00,0x00,0x00,0x00,0x00,0xFE,0x3F,0x7C,0x1E,0x38,0x0C,0x38,0x0C,
		0x38,0x0C,0x38,0x0C,0x38,0x0C,0x38,0x0C,0x38,0x0C,0x38,0x0C,0x38,0x0C,0x38,0x0C,
		0x38,0x0C,0x38,0x0C,0x38,0x0C,0x38,0x0C,0x38,0x0C,0x3C,0x1C,0x3C,0x1C,0x1F,0x78,
		0x0F,0xF0,0x00,0x00,0x00,0x00,0x00,0x00,0x00,0x00
	},
	{	//V
		0x00,0x00,0x00,0x00,0x00,0x00,0x00,0x00,0xFE,0x7E,0x7C,0x3C,0x38,0x1C,0x3C,0x38,
		0x3C,0x38,0x3C,0x38,0x1C,0x38,0x1E,0x30,0x1E,0x70,0x1E,0x70,0x0E,0x70,0x0F,0x70,
		0x0F,0xE0,0x07,0xE0,0x07,0xE0,0x07,0xE0,0x07,0xC0,0x03,0xC0,0x03,0xC0,0x03,0xC0,
		0x03,0xC0,0x00,0x00,0x00,0x00,0x00,0x00,0x00,0x00
	},
	{	//W
		0x00,0x00,0x00,0x00,0x00,0x00,0x00,0x00,0xFF,0xDF,0xF7,0x8E,0x73,0x8E,0x7B,0xCE,
		0x7B,0xCC,0x7B,0xCC,0x7F,0xCC,0x7F,0xDC,0x3F,0xDC,0x3F,0xF8,0x3F,0xF8,0x3F,0xF8,
		0x3F,0xF8,0x3E,0xF8,0x1E,0xF8,0x1E,0xF0,0x1E,0xF0,0x1E,0xF0,0x1E,0xF0,0x1E,0xF0,
		0x0C,0x60,0x00,0x00,0x00,0x00,0x00,0x00,0x00,0x00
	},
	{	//X
		0x00,0x00,0x00,0x00,0x00,0x00,0x00,0x00,0xFE,0x7E,0x78,0x3C,0x3C,0x38,0x3C,0x70,
		0x1E,0x70,0x1E,0xE0,0x0E,0xE0,0x0F,0xC0,0x07,0xC0,0x07,0x80,0x03,0xC0,0x07,0xC0,
		0x07,0xE0,0x0F,0xE0,0x0C,0xF0,0x1C,0xF0,0x18,0x78,0x38,0x78,0x30,0x38,0x70,0x3C,
		0xF8,0xFF,0x00,0x00,0x00,0x00,0x00,0x00,0x00,0x00
	},
	{	//Y
		0x00,0x00,0x00,0x00,0x00,0x00,0x00,0x00,0xFE,0x3F,0x78,0x1C,0x3C,0x1C,0x3C,0x38,
		0x1C,0x38,0x1E,0x30,0x1E,0x70,0x0F,0x60,0x0F,0xE0,0x07,0xE0,0x07,0xC0,0x03,0xC0,
		0x03,0x80,0x03,0x80,0x03,0x80,0x03,0x80,0x03,0x80,0x03,0x80,0x03,0x80,0x07,0xC0,
		0x0F,0xF0,0x00,0x00,0x00,0x00,0x00,0x00,0x00,0x00
	},
	{	//Z
		0x00,0x00,0x00,0x00,0x00,0x00,0x00,0x00,0x1F,0xFE,0x1F,0x1E,0x3C,0x1C,0x38,0x3C,
		0x30,0x38,0x30,0x78,0x00,0xF0,0x00,0xE0,0x01,0xE0,0x01,0xC0,0x03,0xC0,0x03,0x80,
		0x07,0x80,0x07,0x00,0x0F,0x00,0x1E,0x06,0x1C,0x0E,0x3C,0x0E,0x38,0x1C,0x78,0x7C,
		0x7F,0xFC,0x00,0x00,0x00,0x00,0x00,0x00,0x00,0x00
	},
	{	//-
		0x00,0x00,0x00,0x00,0x00,0x00,0x00,0x00,0x00,0x00,0x00,0x00,0x00,0x00,0x00,0x00,
		0x00,0x00,0x00,0x00,0x00,0x00,0x00,0x00,0x00,0x00,0x00,0x00,0x7F,0xFC,0x00,0x00,
		0x00,0x00,0x00,0x00,0x00,0x00,0x00,0x00,0x00,0x00,0x00,0x00,0x00,0x00,0x00,0x00,
		0x00,0x00,0x00,0x00,0x00,0x00,0x00,0x00,0x00,0x00
	}
};

const unsigned char rmb_yuan[] = {
	0x00,0x00,0x00,0x00,0x00,0x00,0x00,0x00,0x00,0x00,0x03,0x00,0x00,0x00,0x07,0x80,
	0x03,0xFF,0xFF,0x80,0x00,0x00,0x00,0x00,0x00,0x00,0x00,0x00,0x00,0x00,0x00,0x00,
	0x00,0x00,0x00,0x00,0x00,0x00,0x00,0xC0,0x00,0x00,0x01,0xE0,0x3F,0xFF,0xFF,0xF0,
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	0x00,0x00,0x00,0x00
};

const unsigned char volume_unit[] = {
	0x00,0x00,0x00,0x00,0x00,0x00,0x00,0x00,0x00,0x03,0xBE,0x00,0x00,0x1F,0xDC,0x00,
	0x00,0xFF,0xDC,0x00,0x0F,0xF8,0x1C,0x00,0x1E,0x78,0x1C,0x00,0x00,0x78,0x1C,0x00,
	0x00,0x78,0x1C,0x00,0x00,0x78,0x1C,0x00,0x00,0x78,0x1C,0x00,0x00,0x78,0x1C,0x60,
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	0x00,0x00,0x00,0x00
};

const unsigned int ICON_INDEX_PAGEADR = ((((94*94*32) + (16*256)) + 528) / 528) * 528;

typedef struct {
	unsigned char noMain;
	unsigned char noSlave;
	unsigned char compress;
	unsigned char count;
	unsigned short x;
	unsigned short y;
	unsigned short width;
	unsigned short height;
	unsigned int startAdr;
	unsigned int size;
}IconIndex;

void draw320x240(void)
{
	setLcdControl();
	DrawHorizontalLine(0,320,0);
	DrawHorizontalLine(0,320,1);
	DrawHorizontalLine(0,320,238);
	DrawHorizontalLine(0,320,239);
	DrawRectangle(0,0,319,239);
	DrawRectangle(1,1,318,238);
	DrawHorizontalLine(0,320,20);
	DrawHorizontalLine(0,320,219);
}

/*void ReadLcdStatus(void)
{
	unsigned char tmp;
	
	do
	{
		tmp = READ_DATA8(LcdDataAdr);
	}while(tmp & 0x40);
}*/

void InitLcd(void)
{
	unsigned int i;
	
	//ReadLcdStatus();
	WRITE_DATA8(LcdComAdr,SYSCOM);
	for(i = 0; i < sizeof(SYSTAB); ++i)  {
		//ReadLcdStatus();
		WRITE_DATA8(LcdDataAdr,SYSTAB[i]);
	}
	//ReadLcdStatus();
	WRITE_DATA8(LcdComAdr,SCRCOM);
	for(i = 0; i < sizeof(SCRTAB); ++i) {
		//ReadLcdStatus();
		WRITE_DATA8(LcdDataAdr,SCRTAB[i]);
	}
	//ReadLcdStatus();
	WRITE_DATA8(LcdComAdr,0x5d);
	//ReadLcdStatus();
	WRITE_DATA8(LcdDataAdr,0x00);
	//ReadLcdStatus();
	WRITE_DATA8(LcdDataAdr,0x00);
	//ReadLcdStatus();
	WRITE_DATA8(LcdComAdr,OVLAY);
	//ReadLcdStatus();
	WRITE_DATA8(LcdDataAdr,Logic_XOR_OR);
	
	//ReadLcdStatus();
	WRITE_DATA8(LcdComAdr,CS_RIGHT);
	//ReadLcdStatus();
	WRITE_DATA8(LcdComAdr,CSRW);
	//ReadLcdStatus();
	WRITE_DATA8(LcdDataAdr,0);
	//ReadLcdStatus();
	WRITE_DATA8(LcdDataAdr,0);
	//ReadLcdStatus();
	WRITE_DATA8(LcdComAdr,NWRITE);
	WatchDog();
	for(i = 0; i < 0x8000; ++i) {
		//ReadLcdStatus();
		WRITE_DATA8(LcdDataAdr,0);
	}	
	WatchDog();
	//ReadLcdStatus();
	WRITE_DATA8(LcdComAdr,DISPLAY_ON);
	//ReadLcdStatus();
	WRITE_DATA8(LcdDataAdr,0x55);
	
	draw320x240();
	CreateTimer(TIMER_AUTO,10 * 1000,draw320x240);
}

void setCursor(void)
{
	//ReadLcdStatus();
	WRITE_DATA8(LcdComAdr,CS_RIGHT);
	//ReadLcdStatus();
	WRITE_DATA8(LcdComAdr,CSRW);
	//ReadLcdStatus();
	WRITE_DATA8(LcdDataAdr,0x00);
	//ReadLcdStatus();
	WRITE_DATA8(LcdDataAdr,0x80);
}


void ReadLcd(unsigned short adr,unsigned char typ,unsigned char* pDst,unsigned short len)
{
	unsigned char val;
	unsigned short i;
	
	
	//ReadLcdStatus();
	WRITE_DATA8(LcdComAdr,typ);
	//ReadLcdStatus();
	WRITE_DATA8(LcdComAdr,CSRW);
	//ReadLcdStatus();
	val = adr & 0xff;
	WRITE_DATA8(LcdDataAdr,val);
	//ReadLcdStatus();
	val = adr >> 8;
	WRITE_DATA8(LcdDataAdr,val);
	//ReadLcdStatus();
	WRITE_DATA8(LcdComAdr,MREAD);
	WatchDog();
	for(i = 0; i < len; ++i) {
		//ReadLcdStatus();
		pDst[i] = READ_DATA8(LcdComAdr);
	}
	WatchDog();
}

void WriteLcd(unsigned short adr,unsigned char typ,unsigned char* s,unsigned short len)
{
	unsigned char tmp;
	unsigned short i;
	
	//ReadLcdStatus();
	WRITE_DATA8(LcdComAdr,typ);
	//ReadLcdStatus();
	WRITE_DATA8(LcdComAdr,CSRW);
	tmp = adr & 0xff;
	//ReadLcdStatus();
	WRITE_DATA8(LcdDataAdr,tmp);
	tmp = adr >> 8;
	//ReadLcdStatus();
	WRITE_DATA8(LcdDataAdr,tmp);
	//ReadLcdStatus();
	WRITE_DATA8(LcdComAdr,NWRITE);
	WatchDog();
	for(i = 0; i < len; ++i) {
		//ReadLcdStatus();
		WRITE_DATA8(LcdDataAdr,s[i]);
	}
	WatchDog();
}

void AndOrDis(unsigned char* s,unsigned char r,unsigned char len)
{
	unsigned char i;
	
	for(i = 0; i < len; ++i) {
		s[i] = s[i] & andTab[r] | orTab[r];
	}
}

void HoldHigh(unsigned char* pDst,const unsigned char* s,unsigned char r,unsigned char len)
{
	unsigned char i;
	
	for(i = 0; i < len; ++i) {
		pDst[i] = s[i] & holdHigh[r];
	}
}

void HoldLow(unsigned char* pDst,const unsigned char* s,unsigned char r,unsigned char len)
{
	unsigned char i;
	
	for(i = 0; i < len; ++i) {
		pDst[i] = s[i] & holdLow[r];
	}
}

void Right(unsigned char* pDst,const unsigned char* s,unsigned char r,unsigned char len)
{
	unsigned char i;
	
	for(i = 0; i < len; ++i) {
		pDst[i] = s[i] >> r;
	}
}

void Left(unsigned char* pDst,const unsigned char* s,unsigned char r,unsigned char len)
{
	unsigned char i;
	
	for(i = 0; i < len; ++i) {
		pDst[i] = s[i] << r;
	}
}

void BufOr(unsigned char* pDst,const unsigned char* s1,const unsigned char* s2,unsigned char len)
{
	unsigned char i;
	
	for(i = 0; i < len; ++i) {
		pDst[i] = s1[i] | s2[i];
	}
}

void HighTurnOver(unsigned char* pDst,const unsigned char* s,unsigned char r,unsigned char len)
{
	unsigned char i;
	
	for(i = 0; i < len; ++i) {
		pDst[i] = s[i] | holdLow[r];
		pDst[i] = ~pDst[i];
	}
}

void LowTurnOver(unsigned char* pDst,const unsigned char* s,unsigned char r,unsigned char len)
{
	unsigned char i;
	
	for(i = 0; i < len; ++i) {
		pDst[i] = s[i] | holdHigh[8 - r];
		pDst[i] = ~pDst[i];
	}
}

void centralTurnOver(unsigned char* pDst,const unsigned char* s,unsigned char rh,unsigned char rl,unsigned char len)
{
	unsigned char i;
	
	for(i = 0; i < len; ++i) {
		pDst[i] = s[i] | holdHigh[rh] | holdLow[rl];
		pDst[i] = ~pDst[i];
	}
}

void TrunOver(unsigned char* pDst,const unsigned char* s,unsigned char len)
{
	unsigned char i;
	
	for(i = 0; i < len; ++i) {
		pDst[i] = ~s[i];
	}
}

unsigned char ClearLcd(unsigned short x1,unsigned char y1,unsigned short x2,unsigned char y2)
{
	unsigned short x;
	unsigned char y,i;
	unsigned short adr;
	unsigned char divq_begin,divq_end,divr_begin,divr_end;
	unsigned char buf[256];
	
	if((y1 > 239) || (y2 > 239)) {
		return 1;
	}
	if((x1 > 319) || (x2 > 319)) {
		return 1;
	}
	if(x1 > x2) {
		x = x1;
		x1 = x2;
		x2 = x;
	}
	if(y1 > y2) {
		y = y1;
		y1 = y2;
		y2 = y;
	}
	x2++;
	y2++;
	divq_begin = x1 >> 3;
	divq_end = x2 >> 3;
	divr_begin = x1 & 0x07;
	divr_end = x2 & 0x07;
	adr = y1 * 48 + divq_begin;
	if(divq_begin == divq_end) {
		if(divr_begin != 0) {
			ReadLcd(adr,CS_DOWN,buf,y2 - y1);
			HoldLow(buf,buf,divr_begin,y2 - y1);
			WriteLcd(adr,CS_DOWN,buf,y2 - y1);
		} else {
			ReadLcd(adr,CS_DOWN,buf,y2 - y1);
			HoldHigh(buf,buf,8 - divr_end,y2 - y1);
			WriteLcd(adr,CS_DOWN,buf,y2 - y1);
		}
	} else {
		if(divr_begin == 0) {
			memset(buf,0,y2 - y1);
			for(i = divq_begin; i < divq_end; ++i) {
				WriteLcd(adr,CS_DOWN,buf,y2 - y1);
				adr++;
			}
			if(divr_end != 0) {
				ReadLcd(adr,CS_DOWN,buf,y2 - y1);
				HoldHigh(buf,buf,8 - divr_end,y2 - y1);
				WriteLcd(adr,CS_DOWN,buf,y2 - y1);
			}
		} else {
			ReadLcd(adr,CS_DOWN,buf,y2 - y1);
			HoldHigh(buf,buf,divr_begin,y2 - y1);
			WriteLcd(adr,CS_DOWN,buf,y2 - y1);
			adr++;
			memset(buf,0,y2 - y1);
			for(i = divq_begin + 1; i < divq_end; ++i) {
				WriteLcd(adr,CS_DOWN,buf,y2 - y1);
				adr++;
			}
			if(divr_end != 0) {
				ReadLcd(adr,CS_DOWN,buf,y2 - y1);
				HoldLow(buf,buf,8 - divr_end,y2 - y1);
				WriteLcd(adr,CS_DOWN,buf,y2 - y1);
			}
		}
	}
	setCursor();
	return 0;
}

void DrawHorizontalLine(unsigned short x1,unsigned short x2,unsigned char y)
{
	unsigned short x,adr;
	unsigned char divq_begin,divq_end,divr_begin,divr_end;
	unsigned char val,len;
	unsigned char buf[256];
	
	if(y > 239) {
		return;
	}
	if((x1 > 320) || (x2 > 320)) {
		return;
	}
	if(x1 > x2) {
		x = x1;
		x1 = x2;
		x2 = x;
	}
	divq_begin = x1 >> 3;
	divq_end = x2 >> 3;
	divr_begin = x1 & 0x07;
	divr_end = x2 & 0x07;
	len = divq_end - divq_begin;
	if(divr_begin == 0) {
		if(divq_begin == divq_end) {
			adr = y * 48 + divq_begin;
			ReadLcd(adr,CS_RIGHT,&val,1);
			val &= holdLow[8 - divr_end];
			val |= (0xff & holdHigh[divr_end]);
			WriteLcd(adr,CS_RIGHT,&val,1);
		} else {
			adr = y * 48 + divq_begin;
			memset(buf,0xff,len);
			if(divr_end != 0) {
				adr = y * 48 + divq_end;
				ReadLcd(adr,CS_RIGHT,&buf[len],1);
				buf[len] &= holdLow[8 - divr_end];
				buf[len++] |= (0xff & holdHigh[divr_end]);
			}
			adr = y * 48 + divq_begin;
			WriteLcd(adr,CS_RIGHT,buf,len);
		}
	} else {
		if(divq_begin == divq_end) {
			adr = y * 48 + divq_begin;
			ReadLcd(adr,CS_RIGHT,&val,1);
			val &= holdHigh[divr_begin] & holdLow[8 - divr_end];
			val |= (0xff & holdLow[8 - divr_begin] & holdHigh[divr_end]);
			WriteLcd(adr,CS_RIGHT,&val,1);
		} else {
			adr = y * 48 + divq_begin;
			ReadLcd(adr,CS_RIGHT,buf,1);
			buf[0] &= holdHigh[divr_begin];
			buf[0] |= (0xff & holdLow[8 - divr_begin]);
			memset(&buf[1],0xff,len - 1);
			if(divr_end != 0) {
				adr = y * 48 + divq_end;
				ReadLcd(adr,CS_RIGHT,&buf[len],1);
				buf[len] &= holdLow[8 - divr_end];
				buf[len++] |= (0xff & holdHigh[divr_end]);
			}
			adr = y * 48 + divq_begin;
			WriteLcd(adr,CS_RIGHT,buf,len);
		}
	}
	setCursor();
}

void DrawVerticalline(unsigned short x,unsigned char y1,unsigned char y2)
{
	unsigned char divq,divr,len;
	unsigned char buf[256];
	unsigned short adr;
	
	if(x > 319) {
		return;
	}
	if((y1 > 240) || (y2 > 240)) {
		return;
	}
	if(y1 > y2) {
		len = y1;
		y1 = y2;
		y2 = len;
	}
	memset(buf,0,256);
	len = y2 - y1;
	divq = x >> 3;
	divr = x & 0x07;
	adr = y1 * 48 + divq;
	ReadLcd(adr,CS_DOWN,buf,len);
	//ReadLcd(y2 * 48 + divq,CS_DOWN,&buf[len - 1],1);
	AndOrDis(buf,divr,len);
	WriteLcd(adr,CS_DOWN,buf,len);
	setCursor();
}

void DrawRectangle(unsigned short x1,unsigned char y1,unsigned short x2,unsigned char y2)
{
	DrawHorizontalLine(x1,x2 + 1,y1);
	DrawHorizontalLine(x1,x2 + 1,y2);
	DrawVerticalline(x1,y1,y2 + 1);
    DrawVerticalline(x2,y1,y2 + 1);
}

unsigned char DisplayCartoon(unsigned int no)
{
	IconIndex index;
	unsigned short count;
	unsigned int adr;
	unsigned char buf[528];
	unsigned char i;
	
	adr = ICON_INDEX_PAGEADR;
	READ(ZIMO_ID,buf,adr,528);
	memcpy((unsigned char*)(&count),buf,2);
	if(count == 0xffff) {
		return 1;
	}
	if(count == 0) {
		return 1;
	}
	if(LcdStatus == 0) {
		ClearLcd2Area();
		ClearLcd(2,21,317,218);
		LcdStatus = 1;
	}
	memcpy((unsigned char*)(&index),&buf[2 + sizeof(index)],sizeof(index));
	if((no + 1) > index.count) {
		no = 1;
	} else if(no == 0) {
		no = 1;
	} else {
		no++;
	}
	memcpy((unsigned char*)(&index),&buf[2 + sizeof(index) * no],sizeof(index));
	if(index.compress == 1) {
		DisplayIconFormAutoCompress((unsigned char*)(&index));
	} else {
		DisplayIconFormAuto((unsigned char*)(&index));
	}
	for(i = 0; i < count; ++i) {
		memcpy((unsigned char*)(&index),&buf[2 + sizeof(index) * i],sizeof(index));
		if(index.noMain == 3) {
			break;
		}
	}
	if(index.compress == 1) {
		DisplayIconFormAutoCompress((unsigned char*)(&index));
	} else {
		DisplayIconFormAuto((unsigned char*)(&index));
	}
	setCursor();
	return 0;
}

extern	const char DISPMSG[][20];

void DisplayVerNumber(void)
{
	unsigned char len = strlen(DISPMSG[3]);
	unsigned short x = (318 - len * 8) / 2;
	unsigned char leng = strlen(DISPMSG[2]);
	unsigned short y = (318 - leng * 8) / 2;
	DisplayString12(x,80,(unsigned char*)DISPMSG[3]);
	DisplayString12(y,100,(unsigned char*)DISPMSG[2]);
}

void DisplayOnLine(void)
{
	unsigned char i;
	unsigned short adr;
	unsigned char buf[32],lcdReadBuf[16],tmpBuf[16];
	
	if(IdleFlg & 0x04) {
		for(i = 0; i < 16; ++i) {
			buf[i] = pumpOnline[2 * i];
			buf[16 + i] = pumpOnline[2 * i + 1];
		}
	} else {
		for(i = 0; i < 16; ++i) {
			buf[i] = pumpOffline[2 * i];
			buf[16 + i] = pumpOffline[2 * i + 1];
		}
	}
	adr = 3 * 48;
	ReadLcd(adr,CS_DOWN,lcdReadBuf,16);
	HoldHigh(lcdReadBuf,lcdReadBuf,3,16);
	Right(tmpBuf,buf,3,16);
	BufOr(tmpBuf,lcdReadBuf,tmpBuf,16);
	WriteLcd(adr,CS_DOWN,tmpBuf,16);
	Left(tmpBuf,buf,5,16);
	Right(lcdReadBuf,&buf[16],3,16);
	BufOr(tmpBuf,lcdReadBuf,tmpBuf,16);
	WriteLcd(adr + 1,CS_DOWN,tmpBuf,16);
	ReadLcd(adr + 2,CS_DOWN,lcdReadBuf,16);
	HoldLow(lcdReadBuf,lcdReadBuf,5,16);
	Left(tmpBuf,&buf[16],5,16);
	BufOr(tmpBuf,lcdReadBuf,tmpBuf,16);
	WriteLcd(adr + 2,CS_DOWN,tmpBuf,16);
	for(i = 0; i < 16; ++i) {
		buf[i] = computer_zimo[2 * i];
		buf[16 + i] = computer_zimo[2 * i + 1];
	}
	adr = 3 * 48 + 4;
	ReadLcd(adr,CS_DOWN,lcdReadBuf,16);
	HoldHigh(lcdReadBuf,lcdReadBuf,3,16);
	Right(tmpBuf,buf,3,16);
	BufOr(tmpBuf,lcdReadBuf,tmpBuf,16);
	WriteLcd(adr,CS_DOWN,tmpBuf,16);
	Left(tmpBuf,buf,5,16);
	Right(lcdReadBuf,&buf[16],3,16);
	BufOr(tmpBuf,lcdReadBuf,tmpBuf,16);
	WriteLcd(adr + 1,CS_DOWN,tmpBuf,16);
	ReadLcd(adr + 2,CS_DOWN,lcdReadBuf,16);
	HoldLow(lcdReadBuf,lcdReadBuf,5,16);
	Left(tmpBuf,&buf[16],5,16);
	BufOr(tmpBuf,lcdReadBuf,tmpBuf,16);
	WriteLcd(adr + 2,CS_DOWN,tmpBuf,16);
	if(PosOnline) {
		DrawHorizontalLine(16,38,11);
	}
	setCursor();
}

void DisplayChar8x16(unsigned short x,unsigned char y,unsigned char val)
{	
	unsigned char divq,divr;
	unsigned short adr;
	unsigned int zimoAdr;
	unsigned char lcdReadBuf[16],zimoBuf[16],tmpBuf[16];
	
	zimoAdr = val * 16;
	divq = x >> 3;
	divr = x & 0x07;
	adr = y * 48 + divq;
	if(divr == 0) {
		READ(ZIMO_ID,zimoBuf,zimoAdr,16);
		WriteLcd(adr,CS_DOWN,zimoBuf,16);
	} else {
		ReadLcd(adr,CS_DOWN,lcdReadBuf,16);
		READ(ZIMO_ID,zimoBuf,zimoAdr,16);
		HoldHigh(lcdReadBuf,lcdReadBuf,divr,16);
		Right(tmpBuf,zimoBuf,divr,16);
		BufOr(tmpBuf,tmpBuf,lcdReadBuf,16);
		WriteLcd(adr,CS_DOWN,tmpBuf,16);
		ReadLcd(adr + 1,CS_DOWN,lcdReadBuf,16);
		HoldLow(lcdReadBuf,lcdReadBuf,8 - divr,16);
		Left(tmpBuf,zimoBuf,8 - divr,16);
		BufOr(tmpBuf,tmpBuf,lcdReadBuf,16);
		WriteLcd(adr + 1,CS_DOWN,tmpBuf,16);
	}		
}

void ReadZimo(unsigned char* s,unsigned int adr,unsigned char len)
{
	unsigned char i,buf[256],*p1,*p2;
	
	READ(ZIMO_ID,buf,adr,len);
	p1 = s;
	p2 = &s[len >> 1];
	for(i = 0; i < len; ++i) {
		if((i % 2) == 0) {
			*(p1++) = buf[i];
		} else {
			*(p2++) = buf[i];
		}
	}
}

void DisplayText16x16(unsigned short x,unsigned char y,unsigned char valx,unsigned char valy)
{
	unsigned char divq,divr;
	unsigned short adr;
	unsigned int zimoAdr;
	unsigned char zimoBuf[32],lcdReadBuf[16],tmpBuf[16];
	
	zimoAdr = valx - 0xa1;
	zimoAdr *= 94;
	zimoAdr += valy - 0xa1;
	zimoAdr <<= 5;
	zimoAdr += 0x1000;
	divq = x >> 3;
	divr = x & 0x07;
	adr = y * 48 + divq;
	ReadZimo(zimoBuf,zimoAdr,32);
	if(divr == 0) {
		WriteLcd(adr,CS_DOWN,zimoBuf,16);
		WriteLcd(adr + 1,CS_DOWN,&zimoBuf[16],16);
	} else {
		ReadLcd(adr,CS_DOWN,lcdReadBuf,16);
		HoldHigh(lcdReadBuf,lcdReadBuf,divr,16);
		Right(tmpBuf,zimoBuf,divr,16);
		BufOr(tmpBuf,tmpBuf,lcdReadBuf,16);
		WriteLcd(adr,CS_DOWN,tmpBuf,16);
		Left(tmpBuf,zimoBuf,8 - divr,16);
		Right(lcdReadBuf,&zimoBuf[16],divr,16);
		BufOr(tmpBuf,tmpBuf,lcdReadBuf,16);
		WriteLcd(adr + 1,CS_DOWN,tmpBuf,16);
		Left(tmpBuf,&zimoBuf[16],8 - divr,16);
		ReadLcd(adr + 2,CS_DOWN,lcdReadBuf,16);
		HoldLow(lcdReadBuf,lcdReadBuf,8 - divr,16);
		BufOr(tmpBuf,tmpBuf,lcdReadBuf,16);
		WriteLcd(adr + 2,CS_DOWN,tmpBuf,16);
	}
}

void DisplayString12(unsigned short x,unsigned char y,const unsigned char* s)
{
	unsigned char tmp1,tmp2;
	unsigned short xtmp;
	
	if(s == (unsigned char*)0) {
		return;
	}
	
	tmp1 = *s;
	xtmp = x;
	while(tmp1) {
		if(tmp1 > 0xa0) {
			s++;
			tmp2 = *s;
			DisplayText16x16(xtmp,y,tmp1,tmp2);
			xtmp += 16;
			s++;
		} else {
			DisplayChar8x16(xtmp,y,tmp1);
			xtmp += 8;
			s++;
		}
		tmp1 = *s;
	}
	setCursor();
}

void DisPlayHelp(const unsigned char* s)
{
	unsigned char len;
	unsigned short x;
	
	len = strlen((char*)s);
	if(len > 38) {
		return;
	}
	x = 316 - 8 * len;
	x >>= 1;
	ClearLcd(2,221,317,237);
	DisplayString12(x,221,s);
}

void DisplayLogo(void)
{
	IconIndex index;
	unsigned short count;
	unsigned int adr;
	unsigned char buf[528];
	
	adr = ICON_INDEX_PAGEADR;
	READ(ZIMO_ID,buf,adr,528);
	memcpy((unsigned char*)(&count),buf,2);
	if(count == 0xffff) {
		return;
		}
	if(count == 0) {
		return;
	}
	memcpy((unsigned char*)(&index),&buf[2],sizeof(index));
	if(index.compress == 1) {
		DisplayIconFormAutoCompress((unsigned char*)(&index));
	} else {
		DisplayIconFormAuto((unsigned char*)(&index));
	}
	setCursor();
}

void DisplayContra(unsigned short x1,unsigned char y1,unsigned short x2,unsigned char y2)
{
	unsigned char i,divq_begin,divq_end;
	unsigned char divr_begin,divr_end;
	unsigned short adr;
	unsigned char buf[256],lcdReadBuf[256];
	unsigned short x;
	unsigned char y;
	
	if((y1 > 239) || (y2 > 239)) {
		return;
	}
	if((x1 > 319) || (x2 > 319)) {
		return;
	}
	if(x1 > x2) {
		x = x1;
		x1 = x2;
		x2 = x;
	}
	if(y1 > y2) {
		y = y1;
		y1 = y2;
		y2 = y;
	}
	x2++;
	y2++;
	divq_begin = x1 >> 3;
	divq_end = x2 >> 3;
	divr_begin = x1 & 0x07;
	divr_end = x2 & 0x07;
	adr = SCRTAB[4];
	adr = (adr << 8) + SCRTAB[3];
	adr += y1 * 48 + divq_begin;
	if(divq_begin == divq_end) {
		if(divr_begin != 0) {
			ReadLcd(adr,CS_DOWN,buf,y2 - y1);
			HoldHigh(lcdReadBuf,buf,divr_begin,y2 - y1);
			HoldLow(lcdReadBuf,lcdReadBuf,8 - divr_end,y2 - y1);
			centralTurnOver(buf,buf,divr_begin,8 - divr_end,y2 - 1);
			BufOr(buf,buf,lcdReadBuf,y2 - y1);
			WriteLcd(adr,CS_DOWN,buf,y2 - y1);
		} else {
			ReadLcd(adr,CS_DOWN,buf,y2 - y1);
			HoldLow(lcdReadBuf,buf,8 - divr_end,y2 - y1);
			HighTurnOver(buf,buf,8 - divr_end,y2 - y1);
			BufOr(buf,buf,lcdReadBuf,y2 - y1);
			WriteLcd(adr,CS_DOWN,buf,y2 - y1);
		}
	} else {
		if(divr_begin == 0) {
			for(i = divq_begin; i < divq_end; ++i) {
				ReadLcd(adr,CS_DOWN,buf, y2 - y1);
				TrunOver(buf,buf,y2 - y1);
				WriteLcd(adr,CS_DOWN,buf,y2 - y1);
				adr++;
			}
			if(divr_end != 0) {
				ReadLcd(adr,CS_DOWN,buf,y2 - y1);
				HoldLow(lcdReadBuf,buf,8 - divr_end,y2 - y1);
				HighTurnOver(buf,buf,8 - divr_end,y2 - y1);
				BufOr(buf,buf,lcdReadBuf,y2 - y1);
				WriteLcd(adr,CS_DOWN,buf,y2 - y1);
			}
		} else {
			ReadLcd(adr,CS_DOWN,buf,y2 - y1);
			HoldHigh(lcdReadBuf,buf,divr_begin,y2 - y1);
			LowTurnOver(buf,buf,8 - divr_begin,y2 - y1);
			BufOr(buf,buf,lcdReadBuf,y2 - y1);
			WriteLcd(adr,CS_DOWN,buf,y2 - y1);
			adr++;
			for(i = divq_begin + 1; i < divq_end; ++i) {
				ReadLcd(adr,CS_DOWN,buf, y2 - y1);
				TrunOver(buf,buf,y2 - y1);
				WriteLcd(adr,CS_DOWN,buf,y2 - y1);
				adr++;
			}
			if(divr_end != 0) {
				ReadLcd(adr,CS_DOWN,buf,y2 - y1);
				HoldLow(lcdReadBuf,buf,8 - divr_end,y2 - y1);
				HighTurnOver(buf,buf,8 - divr_end,y2 - y1);
				BufOr(buf,buf,lcdReadBuf,y2 - y1);
				WriteLcd(adr,CS_DOWN,buf,y2 - y1);
			}
		}
	}
	setCursor();
}

void ClearLcd2Area(void)
{
	unsigned short adr,i;
	
	adr = SCRTAB[4];
	adr = (adr << 8) + SCRTAB[3];
	//ReadLcdStatus();
	WRITE_DATA8(LcdComAdr,CS_RIGHT);
	//ReadLcdStatus();
	WRITE_DATA8(LcdComAdr,CSRW);
	//ReadLcdStatus();
	WRITE_DATA8(LcdDataAdr,SCRTAB[3]);
	//ReadLcdStatus();
	WRITE_DATA8(LcdDataAdr,SCRTAB[4]);
	//ReadLcdStatus();
	WRITE_DATA8(LcdComAdr,NWRITE);
	for(i = 0; i < 0x4000; ++i) {
		//ReadLcdStatus();
		WRITE_DATA8(LcdDataAdr,0);
	}
	setCursor();
}

typedef struct _LcdError
{
	unsigned char len;
	const unsigned char** sta;
}LcdError;

unsigned char ComputeZimo(const unsigned char* s,const unsigned char** p)
{
	unsigned char len = 0;
	
	if(strlen((char*)s) > 16) {
		return 0;
	}
	while(*s) {
		if(*s > '9') {
			*p = NumChar[*s - 0x41 + 10];
		} else if(*s == '-') {
			*p = NumChar[36];
		} else if(*s >= '0') {
			*p = NumChar[*s - 0x30];
		} else {
			return 0;
		}
		*s++;
		*p++;
		len++;
	}
	return len;
}

void DisplayError(unsigned short x,unsigned char y,
				  const unsigned char** p,unsigned char len)
{
	const unsigned char* s;
	unsigned short adr;
	unsigned char i;
	unsigned char buf[58];
	
	adr = y * 48 + (x >> 3);
	while(len--) {
		s = *p;
		for(i = 0; i < 29; ++i) {
			buf[i] = *(s + 2 * i);
			buf[29 + i] = *(s + 2 * i + 1);
		}
		WriteLcd(adr,CS_DOWN,buf,29);
		adr++;
		WriteLcd(adr,CS_DOWN,&buf[29],29);
		adr++;
		p++;
	}
	setCursor();
}

void LcdErr(unsigned short error,unsigned int chipId)
{
	LcdError lcd;
	const unsigned char* p;
	unsigned char buf[64];
	
	memset(&lcd,0,sizeof(LcdError));
	p = buf;
	lcd.sta = &p;
	switch(error)
	{
	case AT45_NOTFIND:
		if(chipId == 0) {
			lcd.len = ComputeZimo(AT45_ERROR0,lcd.sta);
		} else if(chipId == 1) {
			lcd.len = ComputeZimo(AT45_ERROR1,lcd.sta);
		}
		break;
	case RECORD_ERROR:
		lcd.len = ComputeZimo(RECORD_ERR,lcd.sta);
		break;
	case ZIMO_ERROR:
		lcd.len = ComputeZimo(CHARAC_LIB_ERR,lcd.sta);
		break;
	default:
		break;
	}
	if(lcd.len != 0) {
		DisplayError(40,80,lcd.sta,lcd.len);
	}
}

unsigned char PresetDisplay(unsigned char *s,unsigned char point,unsigned char type)
{
	unsigned char i,len;
	unsigned char buf[128],buffer[32];
	unsigned short x;
	unsigned char y;
	unsigned char num;
	unsigned short adr;
	unsigned char* p;
	
	if(s == (unsigned char*)0) {
		return -1;
	}
	len = strlen((char*)s);
	ClearLcd(4,80,310,120);
	DrawRectangle(14,80,306,120);
	DrawRectangle(15,81,305,119);
	x = 304 - 32;
	y = 85;
	if(point == NO) {
		x = x - 16 * len;
		while(*s) {
			adr = y * 48 + (x >> 3);
			num = *s - '0';
			for(i = 0; i < 29; ++i) {
				buf[i] = NumChar[num][2 * i];
				buf[29 + i] = NumChar[num][2 * i + 1];
			}
			WriteLcd(adr,CS_DOWN,buf,29);
			WriteLcd(adr + 1,CS_DOWN,&buf[29],29);
			x += 16;
			s++;
		}
	} else {
		p = buffer;
		if(len < 3) {
			p[0] = '0';
			p[1] = '.';
			if(len == 2) {
				p[2] = *s++;
			} else {
				p[2] = '0';
			}
			p[3] = *s;
			p[4] = '\0';
		} else {
			memcpy(p,s,len - 2);
			p[len - 2] = '.';
			memcpy(&p[len - 1],&s[len - 2],2);
			p[++len] = '\0';
		}
		x = x - 16 * len;
		while(*p) {
			adr = y * 48 + (x >> 3);
			num = *p;
			if(num == '.') {
				num = 36;
			} else {
				num -= '0';
			}
			for(i = 0; i < 29; ++i) {
				buf[i] = NumChar[num][2 * i];
				buf[29 + i] = NumChar[num][2 * i + 1];
			}
			WriteLcd(adr,CS_DOWN,buf,29);
			WriteLcd(adr + 1,CS_DOWN,&buf[29],29);
			x += 16;
			p++;
		}
	}
	if(type == MON) {
		adr = y * 48 + ((304 - 32) >> 3);
		for(i = 0; i < 29; ++i) {
			buf[i] = rmb_yuan[4 * i];
			buf[29 + i] = rmb_yuan[ 4 * i + 1];
			buf[29 * 2 + i] = rmb_yuan[4 * i + 2];
			buf[29 * 3 + i] = rmb_yuan[4 * i + 3];
		}
		WriteLcd(adr,CS_DOWN,buf,29);
		WriteLcd(adr + 1,CS_DOWN,&buf[29],29);
		WriteLcd(adr + 2,CS_DOWN,&buf[29 * 2],29);
		WriteLcd(adr + 3,CS_DOWN,&buf[29 * 3],29);
	} else {
		adr = y * 48 + ((304 - 32) >> 3);
		for(i = 0; i < 29; ++i) {
			buf[i] = volume_unit[4 * i];
			buf[29 + i] = volume_unit[ 4 * i + 1];
			buf[29 * 2 + i] = volume_unit[4 * i + 2];
			buf[29 * 3 + i] = volume_unit[4 * i + 3];
		}
		WriteLcd(adr,CS_DOWN,buf,29);
		WriteLcd(adr + 1,CS_DOWN,&buf[29],29);
		WriteLcd(adr + 2,CS_DOWN,&buf[29 * 2],29);
		WriteLcd(adr + 3,CS_DOWN,&buf[29 * 3],29);
	}
	setCursor();
	return 0;
}

typedef struct {
	IconIndex index;
	unsigned int startAdr;
	unsigned int endAdr;
}IconZimoStruct;

static IconZimoStruct iconZimo;

unsigned char readIconZimo(IconIndex* pIconIndex,unsigned int adr)
{
	unsigned char val;
	unsigned int len;
	
	if(memcmp(pIconIndex,&iconZimo.index,sizeof(IconIndex))) {
		memcpy((unsigned char*)(&iconZimo.index),pIconIndex,sizeof(IconIndex));
		len = (adr + 256) > pIconIndex->size ? (pIconIndex->size - adr) : 256;
		READ(ZIMO_ID,DisBuf,pIconIndex->startAdr + adr,len);
		iconZimo.startAdr = adr;
		iconZimo.endAdr = adr + len;
	} else {
		if(adr < iconZimo.startAdr) {
			len = (adr + 256) > pIconIndex->size ? (pIconIndex->size - adr) : 256;
			READ(ZIMO_ID,DisBuf,pIconIndex->startAdr + adr,len);
			iconZimo.startAdr = adr;
			iconZimo.endAdr = adr + len;
		} else if(adr >= iconZimo.endAdr) {
			len = (adr + 256) > pIconIndex->size ? (pIconIndex->size - adr) : 256;
			READ(ZIMO_ID,DisBuf,pIconIndex->startAdr + adr,len);
			iconZimo.startAdr = adr;
			iconZimo.endAdr = adr + len;
		}
	}
	val = DisBuf[adr - iconZimo.startAdr];
	return val;
}

void DisplayIconFormAutoCompress(unsigned char* s)
{
	unsigned char divq_begin,divq_end,divr_begin,divr_end;
	unsigned char j;
	unsigned char buf[256];
	unsigned short adr;
	unsigned int readAdr;
	unsigned short count;
	unsigned char tmp,val,len;
	unsigned char lcdVal,zimoVal;
	unsigned char typ = 0;
	IconIndex* pIconIndex = (IconIndex*)s;
	
	if(pIconIndex->x > 319) {
		return;
	}
	if((pIconIndex->x + pIconIndex->width) > 319) {
		return;
	}
	if(pIconIndex->y > 239) {
		return;
	}
	if((pIconIndex->y + pIconIndex->height) > 239) {
		return;
	}
	divq_begin = pIconIndex->x >> 3;
	divq_end = (pIconIndex->x + pIconIndex->width) >> 3;
	divr_begin = pIconIndex->x & 0x07;
	divr_end = (pIconIndex->x + pIconIndex->width) & 0x07;
	if(divq_begin == divq_end) {
		typ = 0;
	} else {
		if(divr_begin != 0) {
			typ = 1;
		} else if(divr_end != 0) {
			typ = 2;
		} else {
			typ = 3;
		}
	}
	adr = pIconIndex->y * 48 + divq_begin;
	j = 0;
	for( readAdr = 0; readAdr < pIconIndex->size; ++readAdr) {
		count = 0;
		tmp = readIconZimo(pIconIndex,readAdr);
		if(tmp == 0x00) {
			val = 0x00;
			readAdr++;
			tmp = readIconZimo(pIconIndex,readAdr);
			if(tmp == 0x00) {
				readAdr++;
				tmp = readIconZimo(pIconIndex,readAdr);
				readAdr++;
				count = readIconZimo(pIconIndex,readAdr);
				count = (count << 8) + tmp;
			} else {
				count = tmp;
			}
		} else if(tmp == 0xff) {
			val = 0xff;
			readAdr++;
			tmp = readIconZimo(pIconIndex,readAdr);
			if(tmp == 0x00) {
				readAdr++;
				tmp = readIconZimo(pIconIndex,readAdr);
				readAdr++;
				count = readIconZimo(pIconIndex,readAdr);
				count = (count << 8) + tmp;
			} else {
				count = tmp;
			}
		} else {
			if(typ == 0) {
				ReadLcd(adr,CS_RIGHT,&lcdVal,1);
				lcdVal &= holdHigh[divr_begin];
				lcdVal &= holdLow[8 - divr_end];
				zimoVal = tmp & holdLow[8 - divr_begin];
				zimoVal &= holdHigh[divr_end];
				zimoVal |= lcdVal;
				WriteLcd(adr,CS_RIGHT,&zimoVal,1);
				adr += 48;
			} else if(typ == 1) {
				if(j == 0) {
					ReadLcd(adr,CS_RIGHT,&lcdVal,1);
					lcdVal &= holdHigh[divr_begin];
					zimoVal = tmp >> divr_begin;
					buf[j++] = lcdVal | zimoVal;
					zimoVal = tmp << (8 - divr_begin);
				} else {
					lcdVal = tmp >> divr_begin;
					buf[j++] = lcdVal | zimoVal;
					zimoVal = tmp << (8 - divr_begin);
					lcdVal = 0;
					if(j == (divq_end - divq_begin)) {
						ReadLcd(adr + divq_end - divq_begin,CS_RIGHT,&lcdVal,1);
						if(divr_end != 0) {
							zimoVal &= holdHigh[divr_end];
							lcdVal &= holdLow[8 - divr_end];
						}
						buf[j++] = zimoVal | lcdVal;
						WriteLcd(adr,CS_RIGHT,buf,j);
						j = 0;
						adr += 48;
					}
				}
			} else if(typ == 2) {
				if(j == (divq_end - divq_begin)) {
					ReadLcd(adr + divq_end - divq_begin,CS_RIGHT,&lcdVal,1);
					tmp &= holdHigh[divr_end];
					lcdVal &= holdLow[8 - divr_end];
					buf[j++] = tmp | lcdVal;
					WriteLcd(adr,CS_RIGHT,buf,j);
					j = 0;
					adr += 48;
				} else {
					buf[j++] = tmp;
				}
			} else {
				buf[j++] = tmp;
				if(j == (divq_end - divq_begin)) {
					WriteLcd(adr,CS_RIGHT,buf,j);
					j = 0;
					adr += 48;
				}
			}
		}
		while(count) {
			if(typ == 0) {
				ReadLcd(adr,CS_RIGHT,&lcdVal,1);
				lcdVal &= holdHigh[divr_begin];
				lcdVal &= holdLow[8 - divr_end];
				zimoVal = val & holdLow[8 - divr_begin];
				zimoVal &= holdHigh[divr_end];
				zimoVal |= lcdVal;
				WriteLcd(adr,CS_RIGHT,&zimoVal,1);
				adr += 48;
			} else if(typ == 1) {
				if(j == 0) {
					ReadLcd(adr,CS_RIGHT,&lcdVal,1);
					lcdVal &= holdHigh[divr_begin];
					zimoVal = val >> divr_begin;
					buf[j++] = lcdVal | zimoVal;
					zimoVal = val << (8 - divr_begin);
					count--;
				} else {
					lcdVal = val >> divr_begin;
					buf[j++] = lcdVal | zimoVal;
					zimoVal = val << (8 - divr_begin);
					count--;
					if(j == (divq_end - divq_begin)) {
						ReadLcd(adr + divq_end - divq_begin,CS_RIGHT,&lcdVal,1);
						if(divr_end != 0) {
							zimoVal &= holdHigh[divr_end];
							lcdVal &= holdLow[8 - divr_end];
						}
						buf[j++] = zimoVal | lcdVal;
						WriteLcd(adr,CS_RIGHT,buf,j);
						j = 0;
						adr += 48;
					}
				}
			} else if(typ == 2) {
				len = count > (divq_end - divq_begin - j) ? (divq_end - divq_begin - j) : count;
				count -= len;
				memset(&buf[j],val,len);
				j += len;
				if(j == (divq_end - divq_begin)) {
					if(count != 0) {
						ReadLcd(adr + divq_end - divq_begin,CS_RIGHT,&lcdVal,1);
						tmp = val & holdHigh[divr_end];
						lcdVal &= holdLow[8 - divr_end];
						buf[j++] = tmp | lcdVal;
						WriteLcd(adr,CS_RIGHT,buf,j);
						j = 0;
						adr += 48;
						count--;
					}
				}
			} else {
				len = count > (divq_end - divq_begin - j) ? (divq_end - divq_begin - j) : count;
				count -= len;
				memset(&buf[j],val,len);
				j += len;
				if(j == (divq_end - divq_begin)) {
					WriteLcd(adr,CS_RIGHT,buf,j);
					j = 0;
					adr += 48;
				}
			}
		}
	}
	setCursor();
}

void DisplayIconFormAuto(unsigned char* s)
{
	unsigned char divq_begin,divq_end,divr_begin,divr_end;
	unsigned char i,j,lcdVal;
	unsigned char zimoBuf[256],lcdBuf[256];
	unsigned short adr, zimoAdr;
	unsigned char len;
	IconIndex* pIconIndex = (IconIndex*)s;
	
	if(pIconIndex->x > 319) {
		return;
	}
	if((pIconIndex->x + pIconIndex->width) > 319) {
		return;
	}
	if(pIconIndex->y > 239) {
		return;
	}
	if((pIconIndex->y + pIconIndex->height) > 239) {
		return;
	}
	divq_begin = pIconIndex->x >> 3;
	divq_end = (pIconIndex->x + pIconIndex->width) >> 3;
	divr_begin = pIconIndex->x & 0x07;
	divr_end = (pIconIndex->x + pIconIndex->width) & 0x07;
	adr = pIconIndex->y * 48 + divq_begin;
	zimoAdr = pIconIndex->startAdr;
	if(divq_begin == divq_end) {
		READ(ZIMO_ID,zimoBuf,zimoAdr,pIconIndex->height);	
		ReadLcd(adr,CS_DOWN,lcdBuf,pIconIndex->height);
		HoldHigh(lcdBuf,lcdBuf,divr_begin,pIconIndex->height);
		Right(zimoBuf,zimoBuf,divr_begin,pIconIndex->height);
		HoldLow(lcdBuf,lcdBuf,8 - divr_end,pIconIndex->height);
		HoldHigh(zimoBuf,zimoBuf,divr_end,pIconIndex->height);
		BufOr(zimoBuf,zimoBuf,lcdBuf,pIconIndex->height);
		WriteLcd(adr,CS_DOWN,zimoBuf,pIconIndex->height);
		
	} else {
		len = (pIconIndex->width + 7) >> 3;
		if(divr_begin != 0) {
			for(i = 0; i < pIconIndex->height; ++i) {
				READ(ZIMO_ID,zimoBuf,zimoAdr,len);
				ReadLcd(adr,CS_RIGHT,&lcdVal,1);
				lcdVal &= holdHigh[divr_begin];
				for(j = 0; j < len; ++j) {
					lcdBuf[j] = lcdVal | (zimoBuf[j] >> divr_begin);
					lcdVal = zimoBuf[j] << (8 - divr_begin);
				}
				if(divr_end != 0) {
					ReadLcd(adr + len - 1,CS_RIGHT,zimoBuf,1);
					zimoBuf[0] &= holdLow[8 - divr_end];
					lcdVal |= zimoBuf[0];
				}
				lcdBuf[len] = lcdVal;
				WriteLcd(adr,CS_RIGHT,lcdBuf,len + 1);
				adr += 48;
				zimoAdr += len;
			}
		} else {
			for(i = 0; i < pIconIndex->height; ++i) {
				READ(ZIMO_ID,zimoBuf,zimoAdr,len);
				ReadLcd(adr + len - 1,CS_RIGHT,&lcdVal,1);
				lcdVal &= holdLow[8 - divr_end];
				zimoBuf[len - 1] &= holdHigh[divr_end];
				zimoBuf[len - 1] |= lcdVal;
				WriteLcd(adr,CS_RIGHT,zimoBuf,len);
				adr += 48;
				zimoAdr += len;
			}
		} 
	}
	setCursor();
}

void setLcdControl(void)
{
	unsigned char i;
	
	//ReadLcdStatus();
	WRITE_DATA8(LcdComAdr,SYSCOM);
	for(i = 0; i < sizeof(SYSTAB); ++i)  {
		//ReadLcdStatus();
		WRITE_DATA8(LcdDataAdr,SYSTAB[i]);
	}
	//ReadLcdStatus();
	WRITE_DATA8(LcdComAdr,SCRCOM);
	for(i = 0; i < sizeof(SCRTAB); ++i) {
		//ReadLcdStatus();
		WRITE_DATA8(LcdDataAdr,SCRTAB[i]);
	}
	//ReadLcdStatus();
	WRITE_DATA8(LcdComAdr,0x5d);
	//ReadLcdStatus();
	WRITE_DATA8(LcdDataAdr,0x00);
	//ReadLcdStatus();
	WRITE_DATA8(LcdDataAdr,0x00);
	//ReadLcdStatus();
	WRITE_DATA8(LcdComAdr,OVLAY);
	//ReadLcdStatus();
	WRITE_DATA8(LcdDataAdr,Logic_XOR_OR);
}

#endif